## devices/esp-rtos/main/Kconfig.projbuild
```kconfig
menu "Device configuration"

    config ESP_WIFI_SSID
        string "WiFi SSID"
        default "myssid"
        help
            SSID (network name) for the example to connect to.

    config ESP_WIFI_PASSWORD
        string "WiFi Password"
        default "mypassword"
        help
            WiFi password (WPA or WPA2) for the example to use.

    config ESP_MAXIMUM_RETRY
        int "Maximum retry"
        default 5
        help
            Set the Maximum retry to avoid station reconnecting to the AP unlimited when the AP is really inexistent.

    config BROKER_URL
        string "Broker URL"
        default "mqtt://192.168.1.10:1883/mqtt"
        help
            URL of an mqtt broker which this example connects to.

    config DEVICE_ID
        string "Device ID"
        default ""
        help
            UUID of the device


    config DEVICE_PUBLIC_KEY
        string "Device public key"
        default ""
        help
            Ed25519 public key, must match with this one in database

    config DEVICE_PRIVATE_KEY
        string "Device private key"
        default ""
        help
            Ed25519 private key, must match with public key

    config SERVER_PUBLIC_KEY
        string "Server public key"
        default ""
        help
            Ed25519 public key, must match with the servers public key set in .env

    config DEVICE_OUTPUT_GPIO
        int "Output GPIO PIN"
        range 0 34
        default 0
        help
          GPIO Pin for OUTPUT, 0 for disabled

    choice DEVICE_TYPE
        prompt "Device type"
        default DEVICE_TYPE_LIGHT
        help
          Type of the device

        config DEVICE_TYPE_LIGHT
          bool "Light"
          help
            Light device type

        config DEVICE_TYPE_GARAGE
          bool "Garage"
          help
            Garage device type

        config DEVICE_TYPE_GATE
          bool "Gate"
          help
            Gate device type

        config DEVICE_TYPE_WATER_HEATER
          bool "Water heater"
          help
            Water heater device type

    endchoice

endmenu
```

## devices/esp8266-freertos/main/Kconfig.projbuild
```kconfig
menu "Device configuration"

    config ESP_WIFI_SSID
        string "WiFi SSID"
        default "myssid"
        help
            SSID (network name) for the example to connect to.

    config ESP_WIFI_PASSWORD
        string "WiFi Password"
        default "mypassword"
        help
            WiFi password (WPA or WPA2) for the example to use.

    config ESP_MAXIMUM_RETRY
        int "Maximum retry"
        default 5
        help
            Set the Maximum retry to avoid station reconnecting to the AP unlimited when the AP is really inexistent.

    config BROKER_URL
        string "Broker URL"
        default "mqtt://192.168.1.10:1883/mqtt"
        help
            URL of an mqtt broker which this example connects to.

    config DEVICE_ID
        string "Device ID"
        default ""
        help
            UUID of the device


    config DEVICE_PUBLIC_KEY
        string "Device public key"
        default ""
        help
            Ed25519 public key, must match with this one in database

    config DEVICE_PRIVATE_KEY
        string "Device private key"
        default ""
        help
            Ed25519 private key, must match with public key

    config SERVER_PUBLIC_KEY
        string "Server public key"
        default ""
        help
            Ed25519 public key, must match with the servers public key set in .env

    menu "Device traits"
        config DEVICE_TRAIT_ONOFF
          bool "action.devices.traits.OnOff"
          default false
        
        if DEVICE_TRAIT_ONOFF
          config DEVICE_TRAIT_ONOFF_GPIO
              int "OnOff GPIO Pin"
              help
                GPIO Pin for OnOff

          config DEVICE_TRAIT_ONOFF_EXECUTE
              bool "Execute OnOff state"
              default false
              help
                True if supports executing On/Off state

          config DEVICE_TRAIT_ONOFF_QUERY
              bool "Query OnOff state"
              default false
              help
                True if supports reporting On/Off state
        endif
    endmenu

endmenu
```
